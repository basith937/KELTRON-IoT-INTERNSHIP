#include <Wire.h>
#include <Adafruit_GFX.h>
#include <Adafruit_SSD1306.h>

#define SCREEN_WIDTH 128
#define SCREEN_HEIGHT 64

Adafruit_SSD1306 display(SCREEN_WIDTH, SCREEN_HEIGHT);

const int buttonPin1 = 2;
const int buttonPin2 = 3;
int currentState = 0;

void setup() {
  // put your setup code here, to run once:
  display.begin(SSD1306_SWITCHCAPVCC,0x3C);

  display.clearDisplay();
  display.display();

  pinMode(buttonPin1, INPUT_PULLUP);
  pinMode(buttonPin2, INPUT_PULLUP);

  attachInterrupt(digitalPinToInterrupt(buttonPin1), pic1, FALLING);
  attachInterrupt(digitalPinToInterrupt(buttonPin2), pic2, FALLING);

  

}

void loop() {
  // put your main code here, to run repeatedly:

  switch (currentState) {
    case 0:
    drawScreen_1();
    break;
    case 1:
    drawScreen_2();
    break;
    case 2:
    drawScreen_3();   
    break;
}
}

void pic1() {
  if (currentState > 2) {
    currentState = 0;
  }
  currentState++;
  delay(1000);
  }

void pic2()   {
  if (currentState < 0)
  {
    currentState = 2;
  }
  else{
    currentState--;
  }
  delay(1000);
}


// [BEGIN lopaka generated]
static const unsigned char PROGMEM image_FaceNormal_bits[] = {0x00,0x00,0x00,0x00,0x3c,0x00,0x01,0xe0,0x7a,0x00,0x03,0xd0,0x7e,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0x00,0x00};

void drawScreen_1(void) {
    display.clearDisplay();
    // FaceNormal
    display.drawBitmap(49, 25, image_FaceNormal_bits, 29, 14, 1);
    display.display();
}
// [END lopaka generated]


// [BEGIN lopaka generated]
static const unsigned char PROGMEM image_Pin_arrow_right_bits[] = {0x00,0x00,0x0f,0x00,0x00,0x00,0x00,0x0f,0x00,0x00,0x00,0x00,0x0f,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0x00,0x00};

void drawScreen_2(void) {
    display.clearDisplay();
    // Pin_arrow_right
    display.drawBitmap(59, 28, image_Pin_arrow_right_bits, 36, 28, 1);
    display.display();
}
// [END lopaka generated]


// [BEGIN lopaka generated]
static const unsigned char PROGMEM image_car_bits[] = {0x00,0x00,0x00,0x00,0x00,0x00,0x00,0x00,0x00,0x00,0x00,0x00,0x00,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0x0c,0x00};

void drawScreen_3(void) {
    display.clearDisplay();
    // car
    display.drawBitmap(74, 22, image_car_bits, 38, 32, 1);
    display.display();
}
// [END lopaka generated]

